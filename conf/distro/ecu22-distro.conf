## conf/distro/ecu22-distro.conf
```bitbake
# i.MX DISTRO for the FrameBuffer graphical backend

include conf/distro/include/fsl-imx-base.inc
include conf/distro/include/fsl-imx-preferred-env.inc

DISTRO = "ecu22-distro"

# Remove conflicting backends
DISTRO_FEATURES_remove = " x11 wayland directfb bluetooth alsa irda wifi nfc bluez5 bluez pci 3g pcmci pulseaudio opengl apm "
```

## conf/distro/include/fsl-imx-preferred-env.inc
```bitbake
PREFERRED_PROVIDER_virtual/bootloader_imx = "u-boot-imx"
PREFERRED_PROVIDER_virtual/kernel_imx = "linux-imx"

PREFERRED_VERSION_linux-libc-headers_imx ?= "5.10"

IMX_GPU_VERSION            ?= "6.4.3.p1.2"
IMX_GPU_VERSION_SUFFIX      = "aarch32"
IMX_GPU_VERSION_SUFFIX_mx8  = "aarch64"

PREFERRED_VERSION_imx-gpu-viv               = "${IMX_GPU_VERSION}-${IMX_GPU_VERSION_SUFFIX}"
PREFERRED_VERSION_kernel-module-imx-gpu-viv = "${IMX_GPU_VERSION}"
PREFERRED_VERSION_imx-gpu-g2d               = "${IMX_GPU_VERSION}"

PREFERRED_PROVIDER_opencl-headers_imx = "imx-gpu-viv"

# Use systemd as default init manager
VIRTUAL-RUNTIME_init_manager = "systemd"
PREFERRED_PROVIDER_udev = "systemd"
PREFERRED_PROVIDER_udev-utils = "systemd"
DISTRO_FEATURES_BACKFILL_CONSIDERED = "sysvinit"
POKY_DEFAULT_DISTRO_FEATURES += " systemd"
```

## conf/layer.conf
```bitbake
# We have a conf and classes directory, add to BBPATH
BBPATH .= ":${LAYERDIR}"

# We have a packages directory, add to BBFILES
BBFILES += "${LAYERDIR}/recipes-*/*/*.bb \
            ${LAYERDIR}/recipes-*/*/*.bbappend"

BBFILE_COLLECTIONS += "myir-imx6ulx"
BBFILE_PATTERN_myir-imx6ulx := "^${LAYERDIR}/"
BBFILE_PRIORITY_myir-imx6ulx = "8"
LAYERSERIES_COMPAT_myir-imx6ulx = "gatesgarth"

IMX_DEFAULT_BSP = "nxp"

# Use latest SDMA firmware from firmware-imx instead of upstream linux-firmware
MACHINE_FIRMWARE_remove_mx6  = "linux-firmware-imx-sdma-imx6q"
MACHINE_FIRMWARE_append_mx6  = " firmware-imx-sdma firmware-imx-regulatory"

IMAGE_BOOT_FILES_append = " \
    ${@bb.utils.contains('COMBINED_FEATURES', 'xen', 'xen', '', d)} \
"

# Configure machine feature
MACHINE_FEATURES_append_imx    = " nxp8987"

WKS_FILES = "diskparts.wks"
IMAGE_FSTYPES_append = " wic wic.gz tar.gz"
```

## diskparts.wks
```
# UBoot
# part u-boot --source rawcopy --sourceparams="file=u-boot.imx-sd" --ondisk mmcblk --no-table --align 1 --size 400k

# Main boot partition
part /boot --source bootimg-partition --ondisk mmcblk0 --fstype=vfat --label boot --active --align 4096 --size 16M

# Slave boot partition
part /sboot --source bootimg-partition --ondisk mmcblk0 --fstype=vfat --label boot --align 4096 --size 16M

# Rescue boot partition
part /rboot --source bootimg-partition --ondisk mmcblk0 --fstype=vfat --label boot --align 4096  --size 16M

# RootFS rescue partition
part /rescue --source rootfs --rootfs-dir=core-image-base --ondisk mmcblk0 --fstype=ext4 --label rootfs-rescue --align 4096 --overhead-factor=1.0

# RootFS last partition
part /last --source rootfs --rootfs-dir=core-image-base --ondisk mmcblk0 --fstype=ext4 --label rootfs-last --align 4096 --overhead-factor=1.0

# RootFS main partition
part / --source rootfs --rootfs-dir=core-image-base --ondisk mmcblk0 --fstype=ext4 --label rootfs --align 4096 --overhead-factor=1.0

# User data partition
#part /data --ondisk mmcblk --fstype=ext4 --label data --align 1024 --size 3200M

# Bootloader params
bootloader --ptable msdos --timeout=0 --append=""
```

## meta-bsp/conf/layer.conf
```bitbake
# We have a conf and classes directory, add to BBPATH
BBPATH .= ":${LAYERDIR}"

# We have a packages directory, add to BBFILES
BBFILES += "${LAYERDIR}/recipes-*/*/*.bb \
            ${LAYERDIR}/recipes-*/*/*.bbappend"

BBFILE_COLLECTIONS += "fsl-bsp-release"
BBFILE_PATTERN_fsl-bsp-release := "^${LAYERDIR}/"
BBFILE_PRIORITY_fsl-bsp-release = "8"
LAYERSERIES_COMPAT_fsl-bsp-release = "gatesgarth"

IMX_DEFAULT_BSP = "nxp"

# Use latest SDMA firmware from firmware-imx instead of upstream linux-firmware
MACHINE_FIRMWARE_remove_mx6  = "linux-firmware-imx-sdma-imx6q"
MACHINE_FIRMWARE_append_mx6  = " firmware-imx-sdma firmware-imx-regulatory"

SOC_DEFAULT_IMAGE_FSTYPES_remove = "wic.gz"
SOC_DEFAULT_IMAGE_FSTYPES_append = " wic.bz2 tar.bz2 ext4 ubi"

# Use the expected value of the ubifs filesystem's volume name in the kernel
UBI_VOLNAME = "rootfs"

# The biggest NANDs on current modules are 256MB.
# This sums up to 2048 LEBs available for the ubifs (-c)
MKUBIFS_ARGS = "-F -m 2048 -e 126976 -c 6144"
UBINIZE_ARGS = "-m 2048 -p 128KiB -s 2048 -O 2048"

IMAGE_BOOT_FILES_append = " \
    ${@bb.utils.contains('COMBINED_FEATURES', 'xen', 'xen', '', d)} \
"

MACHINE_FEATURES_append_imx    = " nxp8987"
```

## meta-bsp/conf/machine/ecu22-imx6ul.conf
```bitbake
#@TYPE: Machine
#@NAME: ECU22 OBU
#@SOC: i.MX6UL
#@DESCRIPTION: Machine configuration for ECU22 MYS6UL board

MACHINEOVERRIDES =. "mx6:mx6ul:mx6ull:"

MACHINENAME= "ecu22_obu"

include conf/machine/include/imx-base.inc
include conf/machine/include/tune-cortexa7.inc

MACHINE_FIRMWARE_append = " linux-firmware-imx-sdma-imx6q"

SOC_FAMILY = "mx6ul"

KERNEL_DEVICETREE = "ecu22-obu.dtb"

UBOOT_CONFIG ??= "${@bb.utils.contains('MACHINE_FEATURES', 'optee', 'sd-optee', 'sd', d)}"
UBOOT_CONFIG ??= "sd emmc nand"
UBOOT_CONFIG[sd] = "ecu22_obu_emmc_config,sd"
UBOOT_CONFIG[emmc] = "ecu22_obu_emmc_config,emmc"
UBOOT_CONFIG[nand] = "ecu22_obu_nand_config,nand"

MACHINE_FEATURES_remove = "apm"
```
